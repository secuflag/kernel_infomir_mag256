## Documentation/devicetree/bindings/sound/sti-aloop.txt
```
=========================================================================================
			sti aloop
=========================================================================================

Required properties:
- compatible		: Should be "st,snd-sti-aloop"
- st,mem-partition-name	: name of the BPA2 audio partition
- card_index		: ALSA card number for aloop card
- num_devices		: number of PCM devices
			  The loop is managed by the same device from playback to capture


Typical usage example:

sti_aloop: sti-aloop {
	compatible = "st,snd-sti-aloop";
	status = "disabled";
	st,mem-partition-name = "audio";
	card_index = <1>;
	num_devices = <4>;
};
```

## Documentation/devicetree/bindings/staging/stcc.txt
```
STMicroelectronics CryptoCore driver
------------------------------------

Required properties:
- compatible : "st,cc"
- reg : Should contain 1 register range (address and length)
- interrupts : Should contain 2 interrupt
- control-words-offset : Should contain one integer
- mbx-offset : Should contain one integer

Example:

cc@aabbccdd {
	compatible		= "st,cc";
	status			= "okay";
	reg			= <0xaabbccdd 0x500>;
	interrupts		= <GIC_SPI 1 IRQ_TYPE_NONE>,
				  <GIC_SPI 2 IRQ_TYPE_NONE>;
	st-control-words-offset	= <0x3>;
	st-mbx-offset		= <0x4>;
};
```

## drivers/pci/host/Kconfig
```kconfig
menu "PCI host controller drivers"
	depends on PCI

config PCI_MVEBU
	bool "Marvell EBU PCIe controller"
	depends on ARCH_MVEBU

config PCIE_DW
	bool

config PCI_EXYNOS
	bool "Samsung Exynos PCIe controller"
	depends on SOC_EXYNOS5440
	select PCIEPORTBUS
	select PCIE_DW

config PCI_TEGRA
	bool "NVIDIA Tegra PCIe controller"
	depends on ARCH_TEGRA

config PCI_ST
	bool "ST STiH41x PCIe controller"
	depends on SOC_STIH416 || SOC_STID127 || SOC_STIH407 || SOC_STI8416

endmenu
```

## drivers/staging/stcc/Kconfig
```kconfig
config ST_CC
	bool "Enable CryptoCore Service"
	default n
	depends on SOC_STIH407 = y
	help
	  This option enable the CryptoCore driver.
	  It enables access to specific loading services.
```

## sound/sti/Kconfig
```kconfig
menuconfig SND_STI
	bool "STI sound devices"
	default y
	help
	  Support for STI sound devices.

if SND_STI

config SND_STI_ALOOP
        tristate "ST loopback driver (PCM)"
        select SND_PCM
        help
          Say 'Y' or 'M' to include support for the ST PCM loopback device.
	  This module returns played samples back to the user space using
	  the standard ALSA PCM device. The same device routs its playback
	  stream onto its capture stream. Module creates number of PCM devices
	  defined in DT. There is the possibility to lock the sampling rate of
	  a device on a given frequency set via ALSA control.

	  To compile this driver as a module, choose M here: the module
	  will be called snd-sti-aloop.

endif	# SND_STI
```
